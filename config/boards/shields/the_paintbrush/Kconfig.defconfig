## config/boards/shields/the_paintbrush/Kconfig.defconfig
```kconfig
if SHIELD_THE_PAINTBRUSH_LEFT || SHIELD_THE_PAINTBRUSH_RIGHT

config ZMK_KEYBOARD_NAME
	default "The Paintbrush"

config I2C
	default y

config SSD1306
	default y

config SSD1306_REVERSE_MODE
	default y

endif
```

## config/west.yml
```yaml
manifest:
  remotes:
    - name: zmkfirmware
      url-base: https://github.com/zmkfirmware
    - name: zmk-ardux
      url-base: https://github.com/arduxio
    - name: petejohanson
      url-base: https://github.com/petejohanson
  projects:
    - name: zmk
      remote: zmkfirmware
      revision: main
      #remote: petejohanson
      #revision: hardware/rp2040-support
      import: app/west.yml
  self:
    path: config
```
